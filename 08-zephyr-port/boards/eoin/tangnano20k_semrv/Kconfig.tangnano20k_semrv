## 08-zephyr-port/boards/eoin/tangnano20k_semrv/board.yml
```yaml
board:
  name: tangnano20k_semrv
  full_name: Tang Nano 20K SemRV (LiteX/VexRiscv soft SoC)
  vendor: eoin
  socs:
    - name: litex_vexriscv
```

## 08-zephyr-port/drivers/Kconfig
```kconfig
config SEMNPU
	bool "SemNPU semantic/inference coprocessor driver"
	default y
	depends on DT_HAS_EOIN_SEMNPU_ENABLED
	help
	  Driver for the memory-mapped SemNPU register file
	  (popand / hamming / streaming int8 dot product).
```

## 08-zephyr-port/dts/bindings/misc/eoin,semnpu.yaml
```yaml
description: |
  SemNPU semantic/inference coprocessor (07-semnpu/rtl/semnpu_regs.v).
  128-bit bitset similarity (POPAND/HAMMING) and streaming int8
  multiply-accumulate (DOT8) behind memory-mapped registers.

compatible: "eoin,semnpu"

include: base.yaml

properties:
  reg:
    required: true
```
